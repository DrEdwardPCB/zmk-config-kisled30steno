## config/boards/shields/kisledsteno30/Kconfig.defconfig
```kconfig
# Copyright (c) 2020 The ZMK Contributors
# and (c) 2022 tubbytwins (Matthew A. Schnoor) and beekeeb
# SPDX-License-Identifier: MIT



if SHIELD_KISLEDSTENO30

config ZMK_KEYBOARD_NAME
    default "KisledSteno30"
# default should be <=16 Character for bluetooth

endif
```

## config/boards/shields/zerosprey42/Kconfig.shield
```kconfig
# Copyright (c) 2020 The ZMK Contributors
# and (c) 2022 tubbytwins (Matthew A. Schnoor) and beekeeb
# SPDX-License-Identifier: MIT

config SHIELD_KISLEDSTENO30
    def_bool $(shields_list_contains,kisledsteno30)
```
